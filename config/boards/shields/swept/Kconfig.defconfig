## config/boards/shields/swept/Kconfig.defconfig
```kconfig
# Copyright (c) 2020 The ZMK Contributors
# SPDX-License-Identifier: MIT

if SHIELD_SOFLE_DONGLE

config ZMK_SPLIT_BLE_ROLE_CENTRAL
	default y

endif

if SHIELD_SOFLE_LEFT || SHIELD_SOFLE_RIGHT || SHIELD_SOFLE_DONGLE 

config ZMK_SPLIT
	default y

config I2C
	default y
      
config ZMK_POINTING
	default y

if ZMK_DISPLAY

config SSD1306
    default y

endif # ZMK_DISPLAY

if LVGL

config LV_Z_VDB_SIZE
    default 64

config LV_DPI_DEF
    default 148

config LV_Z_BITS_PER_PIXEL
    default 1

choice LV_COLOR_DEPTH
    default LV_COLOR_DEPTH_1
endchoice

endif # LVGL

endif
```

## config/west.yml
```yaml
manifest:
  remotes:
    - name: zmkfirmware
      url-base: https://github.com/zmkfirmware
    - name: AYM1607
      url-base: https://github.com/AYM1607
    - name: TooManyLs
      url-base: https://github.com/TooManyLs
    # - name: carrefinho
    #   url-base: https://github.com/carrefinho
    - name: janpfischer
      url-base: https://github.com/janpfischer
  projects:
    - name: zmk
      remote: zmkfirmware
      revision: main
      import: app/west.yml
    - name: zmk-driver-azoteq-iqs5xx
      remote: TooManyLs
      revision: main
    # - name: prospector-zmk-module
    #   remote: carrefinho
    #   revision: core/zephyr-4-1
    - name: zmk-dongle-screen
      remote: janpfischer
      revision: upgrade-4.1
  self:
    path: config
```
